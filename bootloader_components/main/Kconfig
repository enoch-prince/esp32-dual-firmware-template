## bootloader_components/main/Kconfig
```kconfig
menu "Bootloader welcome message"

    config MELLO_BOOTLOADER_WELCOME_MESSAGE
        string "Bootloader welcome message"
        default ""
        help
            Booting up Mello 🤖😎🥕
endmenu
```

## sdkconfig.defaults
```kconfig
# ─── Target ───────────────────────────────────────────────────────────────────
# Redundant with CMakeLists.txt IDF_TARGET but kept here so `idf.py set-target`
# does not silently override it.
# CONFIG_IDF_TARGET="esp32s2"
CONFIG_IDF_TARGET="esp32"

# ─── Flash size ───────────────────────────────────────────────────────────────
# Correct symbol name in IDF v5+  (was ESPTOOLPY_FLASHSIZE_4MB in older IDF)
CONFIG_ESPTOOLPY_FLASHSIZE_4MB=y
CONFIG_ESPTOOLPY_FLASHSIZE="4MB"

# ─── Partition table ──────────────────────────────────────────────────────────
# Correct symbol names in IDF v5+
CONFIG_PARTITION_TABLE_CUSTOM=y
CONFIG_PARTITION_TABLE_CUSTOM_FILENAME="partitions/partitions.csv"
CONFIG_PARTITION_TABLE_OFFSET=0x18000

# ─── OTA / bootloader rollback ────────────────────────────────────────────────
# These live under the BOOTLOADER_ namespace in IDF v5+
# DISABLED: Not required since boot_ctrl and ota_manager handle firmware switching
CONFIG_BOOTLOADER_APP_ROLLBACK_ENABLE=n
CONFIG_BOOTLOADER_APP_ANTI_ROLLBACK=n
# CONFIG_BOOTLOADER_APP_SECURE_VERSION=1

# ─── Bootloader optimization ──────────────────────────────────────────────────
# Reduce image validation to minimum necessary for OTA
CONFIG_BOOTLOADER_SKIP_VALIDATE_IN_DEEP_SLEEP=y
CONFIG_BOOTLOADER_SKIP_VALIDATE_ALWAYS=n

# Disable ESP32 ROM logging during bootloader
CONFIG_BOOTLOADER_ESP32_KEEP_IN_INIT=n

# Disable console/UART output in bootloader (significant size save)
CONFIG_BOOTLOADER_CFG_LOG_BOOTLOADER_LEVEL_ERROR=y

# ─── Security (disabled by default — enable for production) ───────────────────
# These burn eFuses. Irreversible. Test on a sacrificial device first.
# CONFIG_SECURE_BOOT=y
# CONFIG_SECURE_BOOT_V2_ENABLED=y
# CONFIG_SECURE_FLASH_ENC_ENABLED=y

# ─── NVS encryption ───────────────────────────────────────────────────────────
CONFIG_NVS_ENCRYPTION=y

# ─── Networking / TLS ─────────────────────────────────────────────────────────
# Disallow plain HTTP for OTA and disallow skipping TLS cert verification.
# Use =n not =0; Kconfig boolean symbols use y/n.
CONFIG_ESP_HTTPS_OTA_ALLOW_HTTP=n
CONFIG_ESP_TLS_INSECURE=n
CONFIG_ESP_TLS_SKIP_SERVER_CERT_VERIFY=n

# ─── Logging ──────────────────────────────────────────────────────────────────
# Correct symbol names — these are choice-based in IDF v5+
# Reduce bootloader logging to ERROR level to save max space
CONFIG_LOG_DEFAULT_LEVEL_INFO=y
CONFIG_BOOTLOADER_LOG_LEVEL_ERROR=y

# ─── C++ standard library ─────────────────────────────────────────────────────
# Disable C++ exceptions and RTTI
CONFIG_COMPILER_CXX_EXCEPTIONS=n
CONFIG_COMPILER_CXX_RTTI=n

# Enable C++17 support
CONFIG_COMPILER_CXX_STANDARD_17=y


# ─── Stack sizes ──────────────────────────────────────────────────────────────
# The main task needs enough stack for C++20 initialisation
CONFIG_ESP_MAIN_TASK_STACK_SIZE=8192

# ─── MQTT ─────────────────────────────────────────────────────────────────────
# Enable the MQTT component (disabled by default in some IDF versions)
CONFIG_MQTT_ENABLED=y

# ─── MBEDTLS ─────────────────────────────────────────────────────────────────────
CONFIG_MBEDTLS=y
CONFIG_MBEDTLS_CERTIFICATE_BUNDLE=y
CONFIG_MBEDTLS_ECDSA_DETERMINISTIC=y
CONFIG_MBEDTLS_ECP_DP_SECP256R1_ENABLED=y
```
